## conf/distro/imx53dk.conf
```bitbake
require conf/distro/poky.conf

SDK_VERSION = "1.0.0-dev"

DISTRO = "imx53dk"
DISTRO_NAME = "embtom imx53dk"
DISTRO_VERSION = "${SDK_VERSION}"
```

## conf/layer.conf
```bitbake
# We have a conf and classes directory, add to BBPATH
BBPATH .= ":${LAYERDIR}"

# We have recipes-* directories, add to BBFILES
BBFILES += "${LAYERDIR}/recipes-*/*/*.bb ${LAYERDIR}/recipes-*/*/*.bbappend ${LAYERDIR}/images/*.bb"

BBFILE_COLLECTIONS += "meta-imx5"

BBFILE_PATTERN_meta-imx5 = "^${LAYERDIR}/"
BBFILE_PRIORITY_meta-imx5 = "10"

FSL_EULA_FILE = "${LAYERDIR}/EULA"
FSL_MIRROR ?= "http://www.freescale.com/lgfiles/NMG/MAD/YOCTO/"

LAYERSERIES_COMPAT_meta-imx5 = "thud"
LAYERDEPENDS_meta-imx5 = "qt5-layer"
```

## conf/machine/imx53.conf
```bitbake
 
#@TYPE: Machine
#@NAME: imx53 
#@DESCRIPTION: Machine configuration for the imx53 
SOC_FAMILY = "mx5:mx53"
TARGET_ARCH = "arm"
DEFAULTTUNE ?= "armv7a-neon"
include conf/machine/include/tune-cortexa8.inc

MACHINE_SOCARCH = "imx53"
PREFERRED_PROVIDER_virtual/kernel = "linux-stable"
PREFERRED_VERSION_linux-stable ?= "5.0"
#PREFERRED_VERSION_linux-stable ?= "5.1"

MACHINE_EXTRA_RRECOMMENDS += "firmware-imx-sdma-imx53"

DISTRO_FEATURES_remove = "x11 wayland vulkan"
DISTRO_FEATURES_append = " opengl"
#DISTRO_FEATURES_append = " x11 opengl"

################################################################
# Kernel setings
################################################################
KERNEL_IMAGETYPE = "uImage"
UBOOT_ENTRYPOINT = "0x70008000"
UBOOT_LOADADDRESS = "0x70008000"

KERNEL_DEVICETREE ?= "imx53-embtom.dtb"

SERIAL_CONSOLE ?= "115200 ttymxc0"
MACHINE_FEATURES = "ext2 serial usbhost vfat"
MACHINE_ESSENTIAL_EXTRA_RDEPENDS = "kernel-image \
                                    kernel-devicetree"

################################################################
# Image generation
################################################################
IMAGE_CLASSES += "uboot-fitimage"

IMAGE_FSTYPES = "tar.gz jffs2 uboot-itb"
JFFS2_ERASEBLOCK = "0x20000"
EXTRA_IMAGECMD_jffs2 ?= "--pad ${JFFS2_ENDIANNESS} --eraseblock=${JFFS2_ERASEBLOCK} --no-cleanmarkers --faketime"
```
